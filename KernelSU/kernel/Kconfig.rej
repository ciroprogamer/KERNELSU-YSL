## KernelSU/kernel/Kconfig.rej
```kconfig
--- kernel/Kconfig
+++ kernel/Kconfig
@@ -59,6 +59,15 @@ config KSU_SUSFS_SUS_KSTAT
 		- Allow spoofing the kstat of user-defined file/directory.
 		- Effective only on zygote spawned user app process.
 
+config KSU_SUSFS_TRY_UMOUNT
+	bool "Enable to use ksu's try_umount"
+	depends on KSU_SUSFS
+	default y
+	help
+		- Allow using try_umount to umount other user-defined mount paths prior to ksu's default umount paths.
+		- Effective only on zygote spawned umounted user app process.
+
+
 config KSU_SUSFS_SPOOF_UNAME
 	bool "Enable to spoof uname"
 	depends on KSU_SUSFS
```
